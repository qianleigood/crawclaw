## firmware/esp32-assistant/profiles/esp-box-3/sdkconfig.defaults
```kconfig
CONFIG_BOARD_TYPE_ESP_BOX_3=y
CONFIG_OTA_URL="http://crawclaw.local:18789/api/esp32/ota"
CONFIG_LANGUAGE_ZH_CN=y
CONFIG_FLASH_DEFAULT_ASSETS=y
CONFIG_USE_DEFAULT_MESSAGE_STYLE=y
CONFIG_USE_AFE_WAKE_WORD=y
CONFIG_SEND_WAKE_WORD_DATA=y
CONFIG_WAKE_WORD_DETECTION_IN_LISTENING=y
CONFIG_USE_AUDIO_PROCESSOR=y
CONFIG_USE_DEVICE_AEC=y
CONFIG_USE_SERVER_AEC=n
CONFIG_RECEIVE_CUSTOM_MESSAGE=y
```
